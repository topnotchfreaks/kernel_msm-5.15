## block/Kconfig.iosched
```kconfig
# SPDX-License-Identifier: GPL-2.0
config IOSCHED_NOOP
	bool
	default y
	help
	  "The no-op I/O scheduler is a minimal scheduler that does basic merging
	   and sorting. Its main uses include non-disk based block devices like
	   memory devices, and specialized software or hardware environments
	   that do their own scheduling and require only minimal assistance from
	   the kernel."

config IOSCHED_DEADLINE
	tristate "Deadline I/O scheduler"
	default y
	help
	  "The deadline I/O scheduler is simple and compact. It provides deadline-based
	   I/O request expiration, ensuring timely processing of requests."

config IOSCHED_CFQ
	tristate "CFQ I/O scheduler"
	default y
	help
	  "The CFQ I/O scheduler tries to distribute bandwidth equally
	   among all processes in the system, providing fair and low-latency
	   performance suitable for both desktop and server systems."

config IOSCHED_ANXIETY
	tristate "Anxiety I/O scheduler"
	default n
	help
	  "The Anxiety I/O scheduler prioritizes latency over everything else. 
	   When a request comes in, it will use a lightweight selection algorithm
	   to swiftly process the current pending task."

menu "Default I/O scheduler"
	config DEFAULT_DEADLINE
		bool "Deadline" if IOSCHED_DEADLINE=y

	config DEFAULT_CFQ
		bool "CFQ" if IOSCHED_CFQ=y

	config DEFAULT_ANXIETY
		bool "Anxiety" if IOSCHED_ANXIETY=y

	config DEFAULT_NOOP
		bool "No-op"

endmenu
```

## drivers/jiang_night/Kconfig
```kconfig
# Kconfig for JiangNight Driver
config JIANG_NIGHT_DRIVER
    tristate "JiangNight Advanced Memory Access Driver"
    default m
    help
      This enables the JiangNight driver, providing advanced debugging
      and memory manipulation capabilities via a misc device.
```
