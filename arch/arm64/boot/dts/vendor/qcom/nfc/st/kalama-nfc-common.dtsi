#include <dt-bindings/clock/qcom,rpmh.h>

&qupv3_se0_i2c {
	status = "ok";
	qcom,clk-freq-out = <1000000>;
	#address-cells = <1>;
	#size-cells = <0>;
	st21nfc: st21nfc@08 {
		compatible = "st,st21nfc";
		reg = <0x08>;
		irq-gpios = <&tlmm 55 0x00>;
		reset-gpios = <&tlmm 30 0x00>;
		interrupt-parent = <&tlmm>;
		interrupts = <55 0>;
		interrupt-names = "nfc_irq";
		pinctrl-names = "nfc_active", "nfc_suspend";
		pinctrl-0 = <&nfc_int_active &nfc_enable_active>;
		pinctrl-1 = <&nfc_int_suspend &nfc_enable_suspend>;
		clocks = <&rpmhcc RPMH_LN_BB_CLK2>;
		clock-names = "nfc_ref_clk";
	};
};
