/dts-v1/;
/plugin/;

#include "crow-nfc-common.dtsi"
/ {
	model = "Qualcomm Technologies, Inc. Crow IDP + WCD9395 WCD-DMIC";
	compatible = "qcom,crow-idp", "qcom,crow", "qcom,idp";
	qcom,msm-id = <608 0x10000>;
	qcom,board-id = <34 1>;
};
