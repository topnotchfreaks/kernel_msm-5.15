/dts-v1/;
/plugin/;

#include "crow-nfc-common.dtsi"
/ {
	model = "Qualcomm Technologies, Inc. Crow QRD";
	compatible = "qcom,crow-qrd", "qcom,crow", "qcom,qrd";
	qcom,msm-id = <608 0x10000>;
	qcom,board-id = <11 0>;
};
