/dts-v1/;
/plugin/;

#include "trinket-nfc-common.dtsi"
/ {
    model = "Qualcomm Technologies, Inc. trinket CDP";
    compatible = "qcom,trinket-cdp", "qcom,trinket", "qcom,cdp";
    qcom,msm-id = <467 0x10000>, <468 0x10000>;
    qcom,board-id = <34 0>;
};
