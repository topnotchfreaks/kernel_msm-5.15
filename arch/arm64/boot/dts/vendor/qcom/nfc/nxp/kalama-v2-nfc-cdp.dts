/dts-v1/;
/plugin/;

#include "kalama-v2-nfc-common.dtsi"
/ {
	model = "Qualcomm Technologies, Inc. Kalama CDP";
	compatible = "qcom,kalama-cdp", "qcom,kalama", "qcom,cdp";
	qcom,msm-id = <519 0x20000>, <536 0x20000>;
	qcom,board-id = <0x10001 0>;
};
