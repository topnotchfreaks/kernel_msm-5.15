/dts-v1/;
/plugin/;

#include "crow-nfc-common.dtsi"
/ {
	model = "Qualcomm Technologies, Inc. Crow IDP";
	compatible = "qcom,crow-idp", "qcom,crow", "qcom,idp";
	qcom,msm-id = <608 0x10000>;
	qcom,board-id = <34 0>;
};
