/dts-v1/;
/plugin/;

#include "khaje-nfc-common.dtsi"
/ {
	model = "Qualcomm Technologies, Inc. KHAJE QRD NOWCD9375";
	compatible = "qcom,khaje-qrd", "qcom,khaje", "qcom,qrd";
	qcom,msm-id = <518 0x10000>, <586 0x10000>;
	qcom,board-id = <0x2010B 0>, <0 0x500>;
};
