/dts-v1/;
/plugin/;

#include "trinket-nfc-common.dtsi"
/ {
    model = "Qualcomm Technologies, Inc. trinket RCM";
    compatible = "qcom,trinket-rcm", "qcom,trinket", "qcom,rcm";
    qcom,msm-id = <467 0x10000>, <468 0x10000>;
    qcom,board-id = <34 0>;
};
