/dts-v1/;
/plugin/;

#include "trinket-nfc-common.dtsi"
/ {
    model = "Qualcomm Technologies, Inc. trinket QRD";
    compatible = "qcom,trinket-qrd", "qcom,trinket", "qcom,qrd";
    qcom,msm-id = <467 0x10000>, <468 0x10000>;
    qcom,board-id = <34 0>;
};
