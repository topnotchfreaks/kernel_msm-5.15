#include <dt-bindings/clock/qcom,rpmh.h>

&qupv3_se1_i2c {
    status = "ok";
    nq@28 {
        compatible = "qcom,sn-nci";
        reg = <0x28>;
        qcom,sn-irq = <&tlmm 85 0x00>;
        qcom,sn-ven = <&tlmm 83 0x00>;
        qcom,sn-firm = <&tlmm 84 0x00>;
        qcom,sn-clkreq = <&tlmm 95 0x00>;
        interrupt-parent = <&tlmm>;
        interrupts = <85 0>;
        interrupt-names = "nfc_irq";
        pinctrl-names = "nfc_active", "nfc_suspend";
        pinctrl-0 = <&nfc_int_active &nfc_enable_active
                &nfc_clk_req_active>;
        pinctrl-1 = <&nfc_int_suspend &nfc_enable_suspend
                &nfc_clk_req_suspend>;
    };
};