#include "khaje-sde-display-idp.dtsi"

&soc {
};

&sde_dsi {
        qcom,dsi-default-panel = <&dsi_nt36672e_fhd_plus_90hz_video>;
};

&qupv3_se2_i2c {
        status = "okay";
        qcom,i2c-touch-active="novatek,NVT-ts";
};
