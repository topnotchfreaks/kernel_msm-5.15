/dts-v1/;
/plugin/;

#include "trinket-sde.dtsi"
#include "trinket-sde-display-iot-idp.dtsi"

/ {
	model = "Qualcomm Technologies, Inc. TRINKET IOT IDP Overlay";
	compatible = "qcom,trinket-iot";
	qcom,msm-id = <467 0x10000>, <468 0x10000>;
	qcom,board-id = <34 0>;
};
