/dts-v1/;
/plugin/;

#include "khaje-sde-display-atp.dtsi"

/ {
        model = "Qualcomm Technologies, Inc. Khaje ATP";
        compatible = "qcom,khaje-atp", "qcom,khaje", "qcom,atp";
        qcom,msm-id = <518 0x10000>;
        qcom,board-id = <33 0>;
        qcom,pmic-id = <0x2D 0x2E 0x0 0x0>;
};
