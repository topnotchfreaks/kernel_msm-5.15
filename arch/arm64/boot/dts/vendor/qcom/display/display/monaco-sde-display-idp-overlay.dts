/dts-v1/;
/plugin/;

#include "monaco-sde-display-idp.dtsi"

/ {
	model = "Qualcomm Technologies, Inc. Monaco IDP V1.0";
	compatible = "qcom,monaco";
	qcom,msm-id = <486 0x10000>;
	qcom,board-id = <0x010022 0x0>, <0x010022 0x1>, <0x020022 0x0>,
			<0x030022 0x0>, <0x010021 0x0>, <0x010021 0x1>,
			<0x020022 0x1>, <0x030022 0x1>, <0x010024 0x1>;
};
