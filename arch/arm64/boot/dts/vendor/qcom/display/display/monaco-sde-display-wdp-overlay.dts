/dts-v1/;
/plugin/;

#include "monaco-sde-display-wdp.dtsi"

/ {
	model = "Qualcomm Technologies, Inc. Monaco WDP V1.0";
	compatible = "qcom,monaco";
	qcom,msm-id = <486 0x10000>;
	qcom,board-id = <0x010024 0x0>;
};
