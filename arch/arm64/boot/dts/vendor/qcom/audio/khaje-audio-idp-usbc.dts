/dts-v1/;
/plugin/;

#include "bengal-audio-overlay.dtsi"
/ {
	model = "Qualcomm Technologies, Inc. KHAJE IDP USBC Audio";
	compatible = "qcom,khaje-idp", "qcom,khaje", "qcom,idp";
	qcom,msm-id = <518 0x10000>, <586 0x10000>;
	qcom,board-id = <0x1010022 0>;
	qcom,pmic-id = <0x2D 0x2E 0x0 0x0>;
};

&bengal_snd {
	qcom,msm-mbhc-usbc-audio-supported = <1>;
	qcom,msm-mbhc-hphl-swh = <0>;
	qcom,msm-mbhc-gnd-swh = <0>;
};
