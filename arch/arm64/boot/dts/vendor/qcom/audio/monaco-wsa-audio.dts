/dts-v1/;
/plugin/;

#include "monaco-audio.dtsi"
#include "monaco-wsa-audio.dtsi"

/ {
	model = "Qualcomm Technologies, Inc. Monaco standalone DP V3.0";
	compatible = "qcom,monaco", "qcom,idp";
	qcom,board-id = <0x030022 0x1>;
};
