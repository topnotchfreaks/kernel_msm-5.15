/dts-v1/;
/plugin/;
#include "bengal-audio-overlay.dtsi"

/ {
        model = "Qualcomm Technologies, Inc. KHAJE IDP nopmi tapas";
        compatible = "qcom,khaje-idp", "qcom,khaje", "qcom,idp";
        qcom,msm-id = <586 0x10000>,<518 0x10000>;
        qcom,board-id = <0x20022 0>;
        qcom,pmic-id = <0x2D 0x0 0x0 0x0>;
};
