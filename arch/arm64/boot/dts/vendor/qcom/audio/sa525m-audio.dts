/dts-v1/;
/plugin/;

#include <dt-bindings/clock/qcom,gcc-sdxpinn.h>
#include <dt-bindings/interrupt-controller/arm-gic.h>
#include <dt-bindings/interconnect/qcom,sdxpinn.h>
#include <dt-bindings/regulator/qcom,rpmh-regulator-levels.h>

#include "sa525m-audio.dtsi"
#include "sa525m-audio-overlay.dtsi"

/ {

	model = "Qualcomm Technologies, Inc. SA525M";
	compatible = "qcom,sdxpinn";
	qcom,msm-id=<558 0x10000>, <559 0x10000>;
	qcom,board-id = <0 0>;
};
