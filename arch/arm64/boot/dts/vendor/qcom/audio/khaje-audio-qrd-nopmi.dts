/dts-v1/;
/plugin/;

#include "bengal-audio-qrd.dtsi"
/ {
	model = "Qualcomm Technologies, Inc. KHAJE QRD nopmi overlay";
	compatible = "qcom,khaje-qrd", "qcom,khaje", "qcom,qrd";
	qcom,msm-id = <518 0x10000>, <586 0x10000>;
	qcom,board-id = <0x1000B 0>;
	qcom,pmic-id = <0x2D 0x0 0x0 0x0>;
};
