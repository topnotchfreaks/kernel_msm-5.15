/dts-v1/;
/plugin/;

#include <dt-bindings/interrupt-controller/arm-gic.h>
#include <dt-bindings/clock/qcom,gcc-monaco.h>
#include <dt-bindings/interconnect/qcom,monaco.h>
#include <dt-bindings/regulator/qcom,rpmh-regulator-levels.h>

#include "monaco-audio.dtsi"
#include "monaco-dmic-audio.dtsi"

/ {
	qcom,msm-id = <486 0x10000>;
	qcom,board-id = <0x010022 0x1>;

};


