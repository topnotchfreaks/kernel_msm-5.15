/dts-v1/;
/plugin/;

#include "kona-bt.dtsi"

/ {
       compatible = "qcom,kona", "qcom,kona-iot";
       qcom,msm-id = <481 0x0>, <481 0x10000>, <481 0x20000>, <481 0x20001>, <548 0x20001>;
       qcom,board-id = <0x010020 0x07>, <0x301000b 0x00>, <0x5010008 0x0>, <0x4010008 0x0>, <0x401000b 0x0>, <0x01001f 0x01>;
};
